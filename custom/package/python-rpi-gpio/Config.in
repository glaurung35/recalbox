## custom/package/python-rpi-gpio/Config.in
```kconfig
config BR2_PACKAGE_PYTHON_RPI_GPIO
	bool "python-rpi-gpio"
	depends on BR2_arm || BR2_aarch64
	help
	  A Python module to control the GPIO on a Raspberry Pi.

	  https://github.com/waveform80/rpi-lgpio
```

## package/calamares/Config.in
```kconfig
config BR2_PACKAGE_CALAMARES
	bool "calamares"
	select BR2_PACKAGE_KF5_EXTRA_CMAKE_MODULES
	select BR2_PACKAGE_QT5
	select BR2_PACKAGE_QT5BASE
	select BR2_PACKAGE_QT5BASE_DBUS
	select BR2_PACKAGE_QT5TOOLS
	select BR2_PACKAGE_QT5TOOLS_LINGUIST_TOOLS
	select BR2_PACKAGE_QT5SVG
	select BR2_PACKAGE_YAML_CPP
	select BR2_PACKAGE_KF5
	select BR2_PACKAGE_KF5_KCOREADDONS
	help
	  Distribution-independent installer framework

	  https://github.com/calamares/calamares
```

## package/creativision/Config.in
```kconfig
config BR2_PACKAGE_CREATIVISION
	bool "creativision emulator"
	depends on BR2_INSTALL_LIBSTDCPP
	select BR2_PACKAGE_SDL2
	select BR2_PACKAGE_SDL2_NET
	select BR2_PACKAGE_LIBPNG
	select BR2_PACKAGE_LIBZ
	help
	  VTech CreatiVision emulator

	  https://sourceforge.net/projects/creativisionemulator/

comment "creativision emulator needs a toolchain w/ C++, ALSA and SDL2"
	depends on !BR2_INSTALL_LIBSTDCPP || !BR2_PACKAGE_SDL2 || !BR2_PACKAGE_SDL2_NET || \
		!BR2_PACKAGE_LIBPNG || !BR2_PACKAGE_LIBZ
```

## package/devilutionx/Config.in
```kconfig
config BR2_PACKAGE_DEVILUTIONX
	bool "DevilutionX"
	depends on BR2_INSTALL_LIBSTDCPP
	select BR2_PACKAGE_SDL2
	select BR2_PACKAGE_SDL2_IMAGE
	help
	  Port of Diablo and Hellfire

	  https://github.com/diasurgical/devilutionX/

comment "DevilutionX needs a toolchain w/ C++, and following libraries : sdl2 and sdl2_image"
	depends on !BR2_INSTALL_LIBSTDCPP || !BR2_PACKAGE_SDL2 || !BR2_PACKAGE_SDL2_IMAGE
```

## package/dolphin-emu/Config.in
```kconfig
config BR2_PACKAGE_DOLPHIN_EMU
	bool "dolphin-emu"
	depends on BR2_x86_64 || BR2_aarch64
	select BR2_PACKAGE_LIBEVDEV
	select BR2_PACKAGE_FFMPEG
	select BR2_PACKAGE_ZLIB
	select BR2_PACKAGE_LIBPNG
	select BR2_PACKAGE_LZO
	select BR2_PACKAGE_LIBUSB
	select BR2_PACKAGE_LIBCURL
	select BR2_PACKAGE_SFML if BR2_PACKAGE_XORG7
	select BR2_PACKAGE_BLUEZ5_UTILS
	select BR2_PACKAGE_CAIRO_SCRIPT
	select BR2_PACKAGE_CAIRO
	select BR2_PACKAGE_HIDAPI
	select BR2_PACKAGE_HICOLOR_ICON_THEME if BR2_PACKAGE_XORG7
	select BR2_PACKAGE_QT6 if BR2_PACKAGE_XORG7
	select BR2_PACKAGE_QT6BASE if BR2_PACKAGE_XORG7
	select BR2_PACKAGE_QT6BASE_OPENGL if BR2_PACKAGE_XORG7
	select BR2_PACKAGE_QT6BASE_XCB if BR2_PACKAGE_XORG7
	select BR2_PACKAGE_QT6BASE_EGLFS if BR2_PACKAGE_XORG7
	select BR2_PACKAGE_QT6BASE_FONTCONFIG if BR2_PACKAGE_XORG7
	select BR2_PACKAGE_QT6BASE_GUI if BR2_PACKAGE_XORG7
	select BR2_PACKAGE_QT6BASE_WIDGETS if BR2_PACKAGE_XORG7
	select BR2_PACKAGE_QT6BASE_GIF if BR2_PACKAGE_XORG7
	select BR2_PACKAGE_QT6BASE_JPEG if BR2_PACKAGE_XORG7
	select BR2_PACKAGE_QT6BASE_PNG if BR2_PACKAGE_XORG7
	select BR2_PACKAGE_XORG7 if BR2_PACKAGE_RECALBOX_TARGET_X86_64
	select BR2_PACKAGE_XLIB_LIBXI if (BR2_PACKAGE_RECALBOX_VIDEO_XORG_SERVER || BR2_PACKAGE_RECALBOX_VIDEO_XWAYLAND)
	help
	  A  Nintendo GameCube/Wii emulator.
	  https://github.com/dolphin-emu/dolphin

comment "Dolphin needs x86_64, XORG7 or aarch64"
	depends on (!BR2_x86_64 || !BR2_PACKAGE_XORG7) && !BR2_aarch64
```

## package/gl4es/Config.in
```kconfig
config BR2_PACKAGE_GL4ES
	bool "gl4es"
	depends on BR2_PACKAGE_HAS_LIBGLES
	select BR2_PACKAGE_HAS_LIBGL if !BR2_PACKAGE_LIBGLVND
	help
	  GL4ES is a OpenGL 2.1/1.5 to GL ES 2.0/1.1 translation library,
	  with support for Pandora, ODroid, OrangePI, CHIP, Raspberry PI,
	  Android, Emscripten and AmigaOS4. 
```

## package/hid-nx/Config.in
```kconfig
config BR2_PACKAGE_HID_NX
	bool "hid-nx"
	depends on BR2_LINUX_KERNEL
	help
	  A Nintendo Switch Controllers HID kernel module.
```

## package/ikemen/Config.in
```kconfig
config BR2_PACKAGE_IKEMEN
	bool "ikemen"
	depends on BR2_PACKAGE_HOST_GO_TARGET_ARCH_SUPPORTS
	select BR2_PACKAGE_MESA3D
	select BR2_PACKAGE_LIBGTK3
	select BR2_PACKAGE_OPENAL
	select BR2_PACKAGE_LIBGLFW
	help
	  An open-source fighting game engine that
	  supports MUGEN resources.

	  https://github.com/ikemen-engine/Ikemen-GO

comment "ikemen needs a toolchain w/ threads"
	depends on BR2_PACKAGE_HOST_GO_TARGET_ARCH_SUPPORTS
```

## package/kf5-kconfigwidgets/Config.in
```kconfig
config BR2_PACKAGE_KF5_KCONFIGWIDGETS
	bool "kf5-kconfigwidgets"
	select BR2_PACKAGE_QT5BASE_DBUS
	select BR2_PACKAGE_KF5_EXTRA_CMAKE_MODULES
	select BR2_PACKAGE_KF5_KAUTH
	select BR2_PACKAGE_KF5_KCODECS
	select BR2_PACKAGE_KF5_KGUIADDONS
	select BR2_PACKAGE_KF5_KWIDGETSADDONS
	help
	  KF5 is a set of Qt framework addons, extending Qt in various
	  ways, not only restricted in helping integration in KDE.

	  This package contains the Kconfigwidgets bindings from the
	  KF5 project.

	  https://api.kde.org/frameworks/kconfigwidgets/html/index.html

comment "kf5-kconfigwidgets needs toolchain w/ threads"
	depends on BR2_USE_MMU
	depends on BR2_PACKAGE_MODEM_MANAGER
	depends on !BR2_TOOLCHAIN_HAS_THREADS
```

## package/kf5-kcrash/Config.in
```kconfig
config BR2_PACKAGE_KF5_KCRASH
	bool "kf5-kcrash"
	select BR2_PACKAGE_QT5BASE_DBUS
	select BR2_PACKAGE_KF5_EXTRA_CMAKE_MODULES
	select BR2_PACKAGE_KF5_KWINDOWSYSTEM
	select BR2_PACKAGE_QT5X11EXTRAS
	help
	  KF5 is a set of Qt framework addons, extending Qt in various
	  ways, not only restricted in helping integration in KDE.

	  This package contains the kcrash bindings from the
	  KF5 project.

	  https://api.kde.org/frameworks/kcrash/html/index.html

comment "kf5-kcrash needs toolchain w/ threads"
	depends on BR2_USE_MMU
	depends on BR2_PACKAGE_MODEM_MANAGER
	depends on !BR2_TOOLCHAIN_HAS_THREADS
```

## package/kf5-kguiaddons/Config.in
```kconfig
config BR2_PACKAGE_KF5_KGUIADDONS
	bool "kf5-kguiaddons"
	select BR2_PACKAGE_QT5BASE_DBUS
	select BR2_PACKAGE_KF5_EXTRA_CMAKE_MODULES
	help
	  KF5 is a set of Qt framework addons, extending Qt in various
	  ways, not only restricted in helping integration in KDE.

	  This package contains the kguiaddons bindings from the
	  KF5 project.

	  https://api.kde.org/frameworks/kguiaddons/html/index.html

comment "kf5-kguiaddons needs toolchain w/ threads"
	depends on BR2_USE_MMU
	depends on BR2_PACKAGE_MODEM_MANAGER
	depends on !BR2_TOOLCHAIN_HAS_THREADS
```

## package/kf5-kiconthemes/Config.in
```kconfig
config BR2_PACKAGE_KF5_KICONTHEMES
	bool "kf5-kiconthemes"
	depends on BR2_PACKAGE_PARTED
	select BR2_PACKAGE_QT5BASE_DBUS
	select BR2_PACKAGE_KF5_EXTRA_CMAKE_MODULES
	select BR2_PACKAGE_KF5_KCONFIGWIDGETS
	select BR2_PACKAGE_KF5_KITEMVIEWS
	help
	  KF5 is a set of Qt framework addons, extending Qt in various
	  ways, not only restricted in helping integration in KDE.

	  This package contains the Kiconthemes bindings from the
	  KF5 project.

	  https://api.kde.org/frameworks/kiconthemes/html/index.html

comment "kf5-kpart needs toolchain w/ threads"
	depends on BR2_USE_MMU
	depends on BR2_PACKAGE_MODEM_MANAGER
	depends on !BR2_TOOLCHAIN_HAS_THREADS
```

## package/kf5-kio/Config.in
```kconfig
config BR2_PACKAGE_KF5_KIO
	bool "kf5-kio"
	select BR2_PACKAGE_QT5BASE_DBUS
	select BR2_PACKAGE_KF5_EXTRA_CMAKE_MODULES
	select BR2_PACKAGE_KF5_KSERVICE
	select BR2_PACKAGE_KF5_SOLID
	select BR2_PACKAGE_UTIL_LINUX_LIBMOUNT
	select BR2_PACKAGE_UTIL_LINUX
	select BR2_PACKAGE_ACL
	help
	  KF5 is a set of Qt framework addons, extending Qt in various
	  ways, not only restricted in helping integration in KDE.

	  This package contains the kio bindings from the
	  KF5 project.

	  https://api.kde.org/frameworks/kio/html/index.html

comment "kf5-kio needs toolchain w/ threads"
	depends on BR2_USE_MMU
	depends on BR2_PACKAGE_MODEM_MANAGER
	depends on !BR2_TOOLCHAIN_HAS_THREADS
```

## package/kf5-kparts/Config.in
```kconfig
config BR2_PACKAGE_KF5_KPARTS
	bool "kf5-kparts"
	depends on BR2_PACKAGE_PARTED
	select BR2_PACKAGE_QT5BASE_DBUS
	select BR2_PACKAGE_KF5_EXTRA_CMAKE_MODULES
	select BR2_PACKAGE_KF5_KCONFIG
	select BR2_PACKAGE_KF5_KI18N
	select BR2_PACKAGE_KF5_KICONTHEMES
	select BR2_PACKAGE_KF5_KIO
	select BR2_PACKAGE_KF5_KCRASH
	help
	  KF5 is a set of Qt framework addons, extending Qt in various
	  ways, not only restricted in helping integration in KDE.

	  This package contains the Kparts bindings from the
	  KF5 project.

	  https://api.kde.org/frameworks/kparts/html/index.html

comment "kf5-kpart needs toolchain w/ threads"
	depends on BR2_USE_MMU
	depends on BR2_PACKAGE_MODEM_MANAGER
	depends on !BR2_TOOLCHAIN_HAS_THREADS
```

## package/kf5-kservice/Config.in
```kconfig
config BR2_PACKAGE_KF5_KSERVICE
	bool "kf5-kservice"
	select BR2_PACKAGE_QT5BASE_DBUS
	select BR2_PACKAGE_KF5_EXTRA_CMAKE_MODULES
	select BR2_PACKAGE_KF5_KDBUSADDONS
	help
	  KF5 is a set of Qt framework addons, extending Qt in various
	  ways, not only restricted in helping integration in KDE.

	  This package contains the kservice bindings from the
	  KF5 project.

	  https://api.kde.org/frameworks/kservice/html/index.html

comment "kf5-kservice needs toolchain w/ threads"
	depends on BR2_USE_MMU
	depends on BR2_PACKAGE_MODEM_MANAGER
	depends on !BR2_TOOLCHAIN_HAS_THREADS
```

## package/kf5-kwidgetsaddons/Config.in
```kconfig
config BR2_PACKAGE_KF5_KWIDGETSADDONS
	bool "kf5-kwidgetsaddons"
	select BR2_PACKAGE_QT5BASE_DBUS
	select BR2_PACKAGE_KF5_EXTRA_CMAKE_MODULES
	select BR2_PACKAGE_QT5TOOLS_UIPLUGIN
	help
	  KF5 is a set of Qt framework addons, extending Qt in various
	  ways, not only restricted in helping integration in KDE.

	  This package contains the kwidgetsaddons bindings from the
	  KF5 project.

	  https://api.kde.org/frameworks/kwidgetsaddons/html/index.html

comment "kf5-kwidgetsaddons needs toolchain w/ threads"
	depends on BR2_USE_MMU
	depends on BR2_PACKAGE_MODEM_MANAGER
	depends on !BR2_TOOLCHAIN_HAS_THREADS
```

## package/linapple3/Config.in
```kconfig
config BR2_PACKAGE_LINAPPLE3
	bool "LinApple3"
	depends on BR2_INSTALL_LIBSTDCPP
	depends on BR2_PACKAGE_SDL2
	depends on BR2_PACKAGE_SDL2_IMAGE
	depends on BR2_PACKAGE_SDL2_TTF
	depends on BR2_PACKAGE_LIBCURL
	depends on BR2_PACKAGE_ZLIB
	depends on BR2_PACKAGE_LIBZIP
	help
	  Linapple3 by Recalbox

	  https://gitlab.com/recalbox/packages/standalone/linapple3

comment "LinApple3 needs a toolchain w/ C++, and following librarie : sdl2, sdl2_image, sdl2_ttf, curl, zlib and libzip"
	depends on !BR2_INSTALL_LIBSTDCPP || !BR2_PACKAGE_SDL2 || !BR2_PACKAGE_SDL2_IMAGE || !BR2_PACKAGE_SDL2_TTF || !BR2_PACKAGE_CURL || !BR2_PACKAGE_ZLIB || !BR2_PACKAGE_LIBZIP
```

## package/mesa3d-headers-rpi5/Config.in
```kconfig
config BR2_PACKAGE_MESA3D_HEADERS_RPI5
	bool
	help
	  Mesa 3D, an open-source implementation of the OpenGL
	  specification.

	  This package only installs headers needed by other packages.

	  http://mesa3d.org
```

## package/pikeyd165/Config.in
```kconfig
config BR2_PACKAGE_PIKEYD165
	bool "pikeyd165"
	select BR2_PACKAGE_EVSIEVE
	select BR2_PACKAGE_EVMAPY
	help
	  Pi2Jamma Tool

	  https://github.com/arcadeforge/RetroPieRGB
```

## package/python-evdev/Config.in
```kconfig
config BR2_PACKAGE_EVDEV
	bool "python-evdev"
	help
	  This package provides bindings to the generic input event
	  interface in Linux.

	  https://github.com/gvalkov/python-evdev
```

## package/python-lgpio/Config.in
```kconfig
config BR2_PACKAGE_PYTHON_LGPIO
	bool "python-lgpio"
	select BR2_PACKAGE_LGPIO
	depends on BR2_arm || BR2_aarch64
	help
	  lgpio is a module for Linux Single Board Computers

	  https://abyz.me.uk/lg/py_lgpio.html
```

## package/python-upnpy/Config.in
```kconfig
config BR2_PACKAGE_PYTHON-UPNPY
	bool "python-upnpy"
	select BR2_PACKAGE_PYTHON3
	select BR2_PACKAGE_PYTHON_PYUDEV
	help
	  Lightweight UPnP client library for Python.

	  https://github.com/mark-pippin/upnpy-bugfix
```

## package/recalbox-3mounts/Config.in
```kconfig
config BR2_PACKAGE_RECALBOX_3MOUNTS
	bool "recalbox 3mounts"
	help
	  The 3mounts utility for recalbox
```
