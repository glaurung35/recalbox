## package/recalbox-crt/Config.in
```kconfig
config BR2_PACKAGE_RECALBOX_CRT
	bool "recalbox crt"
	select BR2_PACKAGE_RECALBOX_RGB_DUAL
	select BR2_PACKAGE_RECALBOX_RGB_DUAL_GUNCON2
	select BR2_PACKAGE_RECALBOX_RGB_JAMMA

	help
	  Crt tv support for recalbox

	  https://gitlab.com/recalbox/recalbox
```

## package/recalbox-rgb-jamma/Config.in
```kconfig
config BR2_PACKAGE_RECALBOX_RGB_JAMMA
	bool "Recalbox RGB Jamma dts and driver"
	depends on BR2_LINUX_KERNEL
	select BR2_PACKAGE_RECALBOX_RGB_DUAL
	select BR2_PACKAGE_RECALBOX_I2S_AUDIO
	select BR2_PACKAGE_RPI_USERLAND_TOOLS
	help
	  Support for Recalbox RGB Jamma, the jamma dac
	  for Rasbperry Pi 5, 4, 400, and 3

comment "Recalbox RGB Jamma needs a kernel and headers"
	depends on !BR2_LINUX_KERNEL
```

## package/recalbox-system/Config.in
```kconfig
config BR2_PACKAGE_RECALBOX_SYSTEM
	bool "Recalbox System"
	select BR2_PACKAGE_LBA_FINDER
	select BR2_PACKAGE_AVAHI_DAEMON
	select BR2_PACKAGE_USB_MODESWITCH_DATA
	select BR2_PACKAGE_AVAHI
	select BR2_PACKAGE_RECALBOX_BLUETOOTH
	select BR2_PACKAGE_RECALBOX_WIFI
	select BR2_PACKAGE_BRCM_BT_FIRMWARE
	select BR2_PACKAGE_SAMBA4
	select BR2_PACKAGE_RECALBOX_MANAGER3
	help
	  Install the recalbox system files

choice
	prompt "Recalbox target"
	default BR2_PACKAGE_RECALBOX_TARGET_RPI4
	help
	  Select Recalbox target hardware

config BR2_PACKAGE_RECALBOX_TARGET_RPI0
	bool "rpi0"
	select BR2_PACKAGE_RPI_FIRMWARE

config BR2_PACKAGE_RECALBOX_TARGET_RPI1
	bool "rpi1"
	select BR2_PACKAGE_RPI_FIRMWARE
	select BR2_PACKAGE_RPI_USERLAND

config BR2_PACKAGE_RECALBOX_TARGET_RPIZERO2LEGACY
	bool "rpizero2legacy"
	select BR2_PACKAGE_RPI_FIRMWARE
	select BR2_PACKAGE_RPI_USERLAND

config BR2_PACKAGE_RECALBOX_TARGET_RPI3
	bool "rpi3"
	select BR2_PACKAGE_RPI_FIRMWARE
	select BR2_PACKAGE_MESA3D
	select BR2_PACKAGE_MESA3D_GALLIUM_DRIVER_KMSRO
	select BR2_PACKAGE_MESA3D_GALLIUM_DRIVER_V3D
	select BR2_PACKAGE_MESA3D_GALLIUM_DRIVER_VC4
	select BR2_PACKAGE_MESA3D_OPENGL_ES
	select BR2_PACKAGE_SDL2_KMSDRM
	select BR2_PACKAGE_RECALBOX_CRT
	select BR2_PACKAGE_RPI_DTOVERLAY
	select BR2_PACKAGE_EEPROMUTILS
	select BR2_PACKAGE_RPI_UTILS

config BR2_PACKAGE_RECALBOX_TARGET_RPIZERO2
	bool "rpizero2"
	select BR2_PACKAGE_RPI_FIRMWARE
	select BR2_PACKAGE_MESA3D
	select BR2_PACKAGE_MESA3D_GALLIUM_DRIVER_KMSRO
	select BR2_PACKAGE_MESA3D_GALLIUM_DRIVER_V3D
	select BR2_PACKAGE_MESA3D_GALLIUM_DRIVER_VC4
	select BR2_PACKAGE_MESA3D_OPENGL_ES
	select BR2_PACKAGE_SDL2_KMSDRM
	select BR2_PACKAGE_RECALBOX_CRT
	select BR2_PACKAGE_RPI_DTOVERLAY

config BR2_PACKAGE_RECALBOX_TARGET_RPI4_64
	bool "rpi4_64"
	select BR2_PACKAGE_RPI_FIRMWARE
	select BR2_PACKAGE_RPI_FIRMWARE_VARIANT_PI4
	select BR2_PACKAGE_MESA3D
	select BR2_PACKAGE_MESA3D_GALLIUM_DRIVER_KMSRO
	select BR2_PACKAGE_MESA3D_GALLIUM_DRIVER_V3D
	select BR2_PACKAGE_MESA3D_GALLIUM_DRIVER_VC4
	select BR2_PACKAGE_MESA3D_OPENGL_ES
	select BR2_PACKAGE_SDL2_KMSDRM
	select BR2_PACKAGE_RECALBOX_CRT
	select BR2_PACKAGE_EEPROMUTILS
	select BR2_PACKAGE_RPI_UTILS
	select BR2_PACKAGE_RPI_EEPROM

config BR2_PACKAGE_RECALBOX_TARGET_RPI4
	bool "rpi4"
	select BR2_PACKAGE_RPI_FIRMWARE
	select BR2_PACKAGE_RPI_FIRMWARE_VARIANT_PI4
	select BR2_PACKAGE_MESA3D
	select BR2_PACKAGE_MESA3D_GALLIUM_DRIVER_KMSRO
	select BR2_PACKAGE_MESA3D_GALLIUM_DRIVER_V3D
	select BR2_PACKAGE_MESA3D_GALLIUM_DRIVER_VC4
	select BR2_PACKAGE_MESA3D_OPENGL_ES
	select BR2_PACKAGE_SDL2_KMSDRM
	select BR2_PACKAGE_RECALBOX_CRT
	select BR2_PACKAGE_EEPROMUTILS

config BR2_PACKAGE_RECALBOX_TARGET_RPI5_64
	bool "rpi5_64"
	select BR2_PACKAGE_RPI_FIRMWARE
	select BR2_PACKAGE_RPI_FIRMWARE_VARIANT_PI4
	select BR2_PACKAGE_MESA3D_RPI5
	select BR2_PACKAGE_MESA3D_RPI5_GALLIUM_DRIVER_KMSRO
	select BR2_PACKAGE_MESA3D_RPI5_GALLIUM_DRIVER_V3D
	select BR2_PACKAGE_MESA3D_RPI5_GALLIUM_DRIVER_VC4
	select BR2_PACKAGE_MESA3D_RPI5_OPENGL_ES
	select BR2_PACKAGE_SDL2_KMSDRM
	select BR2_PACKAGE_RECALBOX_CRT
	select BR2_PACKAGE_EEPROMUTILS
	select BR2_PACKAGE_RPI_UTILS
	select BR2_PACKAGE_RPI_EEPROM

config BR2_PACKAGE_RECALBOX_TARGET_ODROIDXU4
	bool "odroidxu4"
	select BR2_PACKAGE_HOST_UBOOT_TOOLS

config BR2_PACKAGE_RECALBOX_TARGET_ODROIDGO2
	bool "odroidgo2"
	select BR2_PACKAGE_PM_UTILS
	select BR2_PACKAGE_ROCKCHIP_MPP
	select BR2_PACKAGE_HOST_UBOOT_TOOLS
	select BR2_PACKAGE_RECALBOX_ROCKCHIP_MALI

config BR2_PACKAGE_RECALBOX_TARGET_RG353X
	bool "Anbernic RG353x family"
	select BR2_PACKAGE_RECALBOX_ROCKCHIP_MALI
	select BR2_PACKAGE_UBOOT_RG353X
	select BR2_PACKAGE_GPTFDISK
	select BR2_PACKAGE_GPTFDISK_SGDISK
	select BR2_PACKAGE_RKWIFIBT

config BR2_PACKAGE_RECALBOX_TARGET_X86
	bool "x86"

config BR2_PACKAGE_RECALBOX_TARGET_X86_64
	bool "x86_64"

endchoice

# configure features
config BR2_PACKAGE_RECALBOX_HAS_LIBGLES
	bool
	default y if \
	  BR2_PACKAGE_RECALBOX_TARGET_RPI1 ||\
	  BR2_PACKAGE_RECALBOX_TARGET_RPIZERO2 ||\
	  BR2_PACKAGE_RECALBOX_TARGET_RPIZERO2LEGACY ||\
	  BR2_PACKAGE_RECALBOX_TARGET_RPI3 ||\
	  BR2_PACKAGE_RECALBOX_TARGET_RPI4 ||\
	  BR2_PACKAGE_RECALBOX_TARGET_RPI4_64 ||\
	  BR2_PACKAGE_RECALBOX_TARGET_RPI5_64 ||\
	  BR2_PACKAGE_RECALBOX_TARGET_ODROIDXU4 ||\
	  BR2_PACKAGE_RECALBOX_TARGET_ODROIDGO2 ||\
	  BR2_PACKAGE_RECALBOX_TARGET_RG353X

config BR2_PACKAGE_RECALBOX_HAS_LIBGLES3
	bool
	default y if \
	  BR2_PACKAGE_RECALBOX_TARGET_RPI4 ||\
	  BR2_PACKAGE_RECALBOX_TARGET_RPI4_64 ||\
	  BR2_PACKAGE_RECALBOX_TARGET_RPI5_64 ||\
	  BR2_PACKAGE_RECALBOX_TARGET_ODROIDXU4 ||\
	  BR2_PACKAGE_RECALBOX_TARGET_ODROIDGO2 ||\
	  BR2_PACKAGE_RECALBOX_TARGET_RG353X

config BR2_PACKAGE_RECALBOX_HAS_VULKAN
	bool
	default y if \
	  BR2_PACKAGE_RECALBOX_TARGET_RPI4_64 ||\
	  BR2_PACKAGE_RECALBOX_TARGET_X86_64
	select BR2_PACKAGE_VULKAN_LOADER
	select BR2_PACKAGE_MESA3D_VULKAN_DRIVER_BROADCOM if BR2_PACKAGE_RECALBOX_TARGET_RPI4_64
	select BR2_PACKAGE_MESA3D_RPI5_VULKAN_DRIVER_BROADCOM if BR2_PACKAGE_RECALBOX_TARGET_RPI5_64
	select BR2_PACKAGE_MESA3D_VULKAN_DRIVER_INTEL if BR2_PACKAGE_RECALBOX_TARGET_X86_64
	select BR2_PACKAGE_MESA3D_VULKAN_DRIVER_HASWELL if BR2_PACKAGE_RECALBOX_TARGET_X86_64
	select BR2_PACKAGE_MESA3D_VULKAN_DRIVER_AMD if BR2_PACKAGE_RECALBOX_TARGET_X86_64

config BR2_PACKAGE_RECALBOX_HAS_KMS
	bool
	default y if \
	  BR2_PACKAGE_RECALBOX_TARGET_RPIZERO2 ||\
	  BR2_PACKAGE_RECALBOX_TARGET_RPI3 ||\
	  BR2_PACKAGE_RECALBOX_TARGET_RPI4 ||\
	  BR2_PACKAGE_RECALBOX_TARGET_RPI4_64 ||\
	  BR2_PACKAGE_RECALBOX_TARGET_RPI5_64 ||\
	  BR2_PACKAGE_RECALBOX_TARGET_ODROIDXU4 ||\
	  BR2_PACKAGE_RECALBOX_TARGET_ODROIDGO2 ||\
	  BR2_PACKAGE_RECALBOX_TARGET_RG353X

config BR2_PACKAGE_RECALBOX_HAS_LIBMALI
	bool
	default y if \
	  BR2_PACKAGE_RECALBOX_TARGET_ODROIDXU4 ||\
	  BR2_PACKAGE_RECALBOX_TARGET_ODROIDGO2 ||\
	  BR2_PACKAGE_RECALBOX_TARGET_RG353X

config BR2_PACKAGE_RECALBOX_EGL_NO_X11
	bool
	default y if \
	  BR2_PACKAGE_RECALBOX_TARGET_RPI1 ||\
	  BR2_PACKAGE_RECALBOX_TARGET_RPIZERO2 ||\
	  BR2_PACKAGE_RECALBOX_TARGET_RPIZERO2LEGACY ||\
	  BR2_PACKAGE_RECALBOX_TARGET_RPI3 ||\
	  BR2_PACKAGE_RECALBOX_TARGET_RPI4 ||\
	  BR2_PACKAGE_RECALBOX_TARGET_RPI4_64 ||\
	  BR2_PACKAGE_RECALBOX_TARGET_RPI5_64 ||\
	  BR2_PACKAGE_RECALBOX_TARGET_ODROIDXU4 ||\
	  BR2_PACKAGE_RECALBOX_TARGET_ODROIDGO2 ||\
	  BR2_PACKAGE_RECALBOX_TARGET_RG353X

# shader slang (used by retroarch)
config BR2_PACKAGE_RECALBOX_HAS_SLANG
	bool
	default y if \
	  BR2_PACKAGE_RECALBOX_TARGET_RPI4_64 ||\
	  BR2_PACKAGE_RECALBOX_TARGET_ODROIDGO2

# various helpers
config BR2_PACKAGE_RECALBOX_RPI_ANY
	bool
	default y if \
	  BR2_PACKAGE_RECALBOX_TARGET_RPI1 ||\
	  BR2_PACKAGE_RECALBOX_TARGET_RPIZERO2 ||\
	  BR2_PACKAGE_RECALBOX_TARGET_RPIZERO2LEGACY ||\
	  BR2_PACKAGE_RECALBOX_TARGET_RPI3 ||\
	  BR2_PACKAGE_RECALBOX_TARGET_RPI4 ||\
	  BR2_PACKAGE_RECALBOX_TARGET_RPI4_64 ||\
	  BR2_PACKAGE_RECALBOX_TARGET_RPI5_64
```

## package/spirv-headers/Config.in.host
```kconfig
config BR2_PACKAGE_HOST_SPIRV_HEADERS
	bool "spirv-headers"
	help
	  The SPIR-V Tools project provides an API and commands for processing SPIR-V modules.
	  https://github.com/KhronosGroup/SPIRV-Headers
```

## package/xemu/Config.in
```kconfig
config BR2_PACKAGE_XEMU
    bool "xemu"
    select BR2_PACKAGE_SDL2
    select BR2_PACKAGE_LIBSAMPLERATE
    select BR2_PACKAGE_SLIRP
    help
        Original Xbox Emulator
        
        https://xemu.app/
```
