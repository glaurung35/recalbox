/dts-v1/;
/plugin/;

/{
	compatible = "brcm,bcm2712";

	fragment@0 {
		target = <&i2c1>;
		frag0: __overlay__ {
			status = "okay";
			clock-frequency = <100000>;
			pinctrl-0 = <&rp1_i2c1_2_3>;
		};
	};

	__overrides__ {
		pins_2_3 = <&frag0>,"pinctrl-0:0=", <&rp1_i2c1_2_3>;
		pins_10_11 = <&frag0>,"pinctrl-0:0=", <&rp1_i2c1_10_11>;
		baudrate = <&frag0>, "clock-frequency:0";
	};
};